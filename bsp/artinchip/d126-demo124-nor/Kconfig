## bsp/artinchip/d126-demo124-nor/Kconfig
```kconfig
mainmenu "RT-Thread Project Configuration"

BSP_DIR := .

RTT_DIR := ../../..

PKGS_DIR := packages

source "$(RTT_DIR)/Kconfig"
osource "$(PKGS_DIR)/Kconfig"

rsource "board/Kconfig"
rsource "drivers/Kconfig"

config BOARD_ARTINCHIP_D126_DEMO124_NOR
    bool
    select ARCH_RISCV32
    select ARCH_RISCV_FPU_S
    select ARCH_RISCV_M_MODE
    select RT_USING_RISCV_NEW_COMMON
    select RT_USING_ADT
    select RT_USING_ADT_BITMAP
    select RT_USING_COMPONENTS_INIT
    select RT_USING_USER_MAIN
    default y

config CPU_BASE
    hex
    default 0x20000000

config AIC_PSRAM_SIZE
    hex "PSRAM size"
    default 0x800000
```

## bsp/artinchip/d126-demo124-nor/board/Kconfig
```kconfig
menu "D126 board options"

config BSP_UART0_BAUD
    int "UART0 console baudrate"
    default 115200

config BSP_USING_SELFTEST
    bool "Enable boot self-test"
    default y

endmenu
```

## bsp/artinchip/d126fxr-demo-v1-1/board/Kconfig
```kconfig
menu "D126 board options"

config BSP_UART0_BAUD
    int "UART0 console baudrate"
    default 115200

config BSP_CLINT_FREQ
    int "CORET timer frequency (Hz)"
    default 4000000

config BSP_USING_SELFTEST
    bool "Enable D126 msh self-test commands"
    default y

config BSP_USING_UTEST
    bool "Enable D126 utest suite"
    default n

endmenu
```

## bsp/artinchip/d213-demo128-nand/Kconfig
```kconfig
mainmenu "RT-Thread Project Configuration"

BSP_DIR := .

RTT_DIR := ../../..

PKGS_DIR := packages

source "$(RTT_DIR)/Kconfig"
osource "$(PKGS_DIR)/Kconfig"

rsource "board/Kconfig"
rsource "drivers/Kconfig"

config BOARD_ARTINCHIP_D213_DEMO128
    bool
    select ARCH_CPU_64BIT
    select ARCH_RISCV
    select ARCH_RISCV64
    select ARCH_RISCV_FPU
    select ARCH_RISCV_FPU_D
    select ARCH_RISCV_M_MODE
    select RT_USING_RISCV_NEW_COMMON
    select RT_USING_ADT
    select RT_USING_ADT_BITMAP
    select RT_USING_COMPONENTS_INIT
    select RT_USING_USER_MAIN
    default y
```

## bsp/artinchip/d213-demo128-nand/board/Kconfig
```kconfig
menu "Board options"

config AIC_DRAM_TOTAL_SIZE
    hex "DRAM total size"
    default 0x8000000
    help
        Total DDR size of the D213 demo128 board.  The bootloader loads the
        RT-Thread image at 0x40000000; the remaining DDR is used as heap.

config AIC_BOOTLOADER_RESERVED_SIZE
    hex "Reserved DDR for the ArtInChip bootloader"
    default 0x800000
    help
        The D213 bootloader is linked near the top of DDR.  Keep this
        region out of the RT-Thread heap so that the bootloader image is
        not overwritten while the OS is running.

config BSP_UART_CLK_FREQ
    int "UART input clock (Hz)"
    default 48000000
    help
        Common UART input clock selected by the ArtInChip bootloader clock
        tree.  All UART instances on the D213 demo128 board use 48 MHz.

config BSP_CLINT_FREQ
    int "CLINT timer frequency (Hz)"
    default 4000000

endmenu

menu "Testing"

config BSP_USING_UTEST
    bool "Enable D213 BSP utest cases"
    default n
    select RT_USING_UTEST
    help
        Builds the D213-specific utest cases under utest/.  The cases use
        the standard RT-Thread utest framework and are registered as
        bsp.d213.*.  This option does not enable the official RT-Thread
        test suite; enable RT-Thread Utestcases separately when needed.

config BSP_UTEST_CAN_LOOPBACK
    bool "Enable D213 CAN0 loopback utest"
    default n
    depends on BSP_USING_UTEST && BSP_USING_CAN0
    help
        Adds the bsp.d213.can0.loopback case.  The D21x SELFTEST mode did
        not receive or complete a frame without external CAN0 TX/RX wiring
        on the demo128 board.  Enable this only when TX and RX are wired
        together, or when a transceiver, termination and an ACK-ing peer
        are connected.

endmenu
```

## bsp/artinchip/d213-demo128-nand/drivers/Kconfig
```kconfig
menu "On-chip Peripheral Drivers"

config BSP_USING_GPIO
    bool "Enable GPIO / pin device"
    default y
    select RT_USING_PIN
    help
        Enables the standard RT-Thread pin device ("gpio") on top of the
        ArtInChip GPIO HAL.  Pin names use the PA.n ... PH.n form.

menu "UART"

config BSP_USING_UART0
    bool "Enable UART0 (console)"
    default y
    select RT_USING_SERIAL

config BSP_USING_UART1
    bool "Enable UART1 (PA.4/PA.5)"
    default y
    select RT_USING_SERIAL

config BSP_USING_UART2
    bool "Enable UART2 (PA.8/PA.9, shared with I2C2)"
    default n
    select RT_USING_SERIAL

config BSP_USING_UART3
    bool "Enable UART3 (board pinmux required)"
    default n
    select RT_USING_SERIAL

config BSP_USING_UART4
    bool "Enable UART4 (PB.6/PB.7, shared with SDMC0/QSPI0)"
    default n
    select RT_USING_SERIAL

config BSP_USING_UART5
    bool "Enable UART5 (board pinmux required)"
    default n
    select RT_USING_SERIAL

config BSP_USING_UART6
    bool "Enable UART6 (board pinmux required)"
    default n
    select RT_USING_SERIAL

config BSP_USING_UART7
    bool "Enable UART7 (board pinmux required)"
    default n
    select RT_USING_SERIAL

endmenu

menu "I2C"

config BSP_USING_I2C0
    bool "Enable I2C0 (PD.6/PD.7)"
    default n
    select RT_USING_I2C

config BSP_USING_I2C1
    bool "Enable I2C1 (PD.18/PD.19)"
    default n
    select RT_USING_I2C

config BSP_USING_I2C2
    bool "Enable I2C2 (PA.8/PA.9, shared with UART2)"
    default n
    select RT_USING_I2C

config BSP_USING_I2C3
    bool "Enable I2C3 (PA.10/PA.11, touch controller)"
    default y
    select RT_USING_I2C

if BSP_USING_I2C0
config BSP_I2C0_SPEED
    int "I2C0 bus speed (Hz)"
    default 400000
config BSP_I2C0_10BIT
    bool "I2C0 uses 10-bit addresses"
    default n
endif

if BSP_USING_I2C1
config BSP_I2C1_SPEED
    int "I2C1 bus speed (Hz)"
    default 400000
config BSP_I2C1_10BIT
    bool "I2C1 uses 10-bit addresses"
    default n
endif

if BSP_USING_I2C2
config BSP_I2C2_SPEED
    int "I2C2 bus speed (Hz)"
    default 400000
config BSP_I2C2_10BIT
    bool "I2C2 uses 10-bit addresses"
    default n
endif

if BSP_USING_I2C3
config BSP_I2C3_SPEED
    int "I2C3 bus speed (Hz)"
    default 400000
config BSP_I2C3_10BIT
    bool "I2C3 uses 10-bit addresses"
    default n
endif

endmenu

menu "Touch"

config BSP_USING_TOUCH_GT911
    bool "Enable GT911 capacitive touch (I2C3)"
    default y
    depends on BSP_USING_I2C3 && BSP_USING_GPIO
    select RT_USING_TOUCH
    select RT_TOUCH_PIN_IRQ
    help
        Enables the GT911 touch controller on I2C3.  The D213EC-DEMO-V4-0
        uses PA.8 for reset and PA.9 for interrupt.

if BSP_USING_TOUCH_GT911
config BSP_TOUCH_GT911_I2C_BUS
    string "GT911 I2C bus name"
    default "i2c3"

config BSP_TOUCH_GT911_RST_PIN
    string "GT911 reset pin"
    default "PA.8"

config BSP_TOUCH_GT911_INT_PIN
    string "GT911 interrupt pin"
    default "PA.9"

config BSP_TOUCH_GT911_X_RANGE
    int "GT911 X coordinate range"
    default 1024

config BSP_TOUCH_GT911_Y_RANGE
    int "GT911 Y coordinate range"
    default 600
endif

endmenu

menu "CAN"

config BSP_USING_CAN0
    bool "Enable CAN0 (classic CAN 2.0A/B, PE.16/PE.17)"
    default y
    select RT_USING_CAN
    help
        Enables the D21x classic CAN controller.  CAN FD is not supported
        by this hardware.

config BSP_USING_CAN1
    bool "Enable CAN1 (classic CAN 2.0A/B, PE.18/PE.19)"
    default y
    select RT_USING_CAN
    help
        Enables the D21x classic CAN controller.  CAN FD is not supported
        by this hardware.

endmenu

config BSP_USING_PWM
    bool "Enable PWM (4 channels, PC.0..PC.7)"
    default y
    select RT_USING_PWM
    help
        PWM0-2 are routed to PC.0-PC.5 by the board pinmux.  PWM3 shares
        PC.6/PC.7 with other functions; PC.7 is the panel enable GPIO, so
        do not use PWM3 while the display is enabled.

config BSP_USING_WDT
    bool "Enable watchdog"
    default y
    select RT_USING_WDT

config BSP_USING_RTC
    bool "Enable RTC"
    default y
    select RT_USING_RTC

config BSP_USING_WRI
    bool "Enable WRI reboot reason and the aicupg command"
    default n
    depends on BSP_USING_WDT
    help
        Exposes "aicupg" and "aicupg gotobl" in MSH.  "aicupg" latches
        REBOOT_REASON_UPGRADE so the BROM enters its USB/UART upgrade loop;
        "aicupg gotobl" latches REBOOT_REASON_BL_UPGRADE for the vendor
        Bootloader upgrade command.  The board is reset through the
        watchdog, which preserves the always-on WRI/RTC boot information.
        The vendor Bootloader must be built with AIC_USING_WRI.
        This option does not implement AICUPG, USB upgrade or NAND writes.

config BSP_USING_PERIPH_TEST
    bool "Enable peripheral MSH test commands"
    default y
    depends on BSP_USING_I2C0 || BSP_USING_I2C1 || BSP_USING_I2C2 || BSP_USING_I2C3 || \
               BSP_USING_CAN0 || BSP_USING_CAN1 || BSP_USING_PWM || BSP_USING_WDT || \
               BSP_USING_RTC || BSP_USING_GPIO || BSP_USING_DISPLAY || BSP_USING_GE

menu "Display"

config BSP_USING_DISPLAY
    bool "Enable D21x DE + LVDS framebuffer"
    default y
    help
        Enables the Display Engine UI layer, LVDS output and the RT-Thread
        graphic device named "lcd".  The framebuffer is carved out of the
        top of the non-bootloader DDR area.

config BSP_DISPLAY_WIDTH
    int "Panel width"
    default 1024
    depends on BSP_USING_DISPLAY

config BSP_DISPLAY_HEIGHT
    int "Panel height"
    default 600
    depends on BSP_USING_DISPLAY

config BSP_DISPLAY_PIXCLOCK
    int "Panel pixel clock (Hz)"
    default 52000000
    depends on BSP_USING_DISPLAY

config BSP_DISPLAY_HFP
    int "Horizontal front porch"
    default 160
    depends on BSP_USING_DISPLAY

config BSP_DISPLAY_HBP
    int "Horizontal back porch"
    default 160
    depends on BSP_USING_DISPLAY

config BSP_DISPLAY_HSW
    int "Horizontal sync width"
    default 20
    depends on BSP_USING_DISPLAY

config BSP_DISPLAY_VFP
    int "Vertical front porch"
    default 20
    depends on BSP_USING_DISPLAY

config BSP_DISPLAY_VBP
    int "Vertical back porch"
    default 12
    depends on BSP_USING_DISPLAY

config BSP_DISPLAY_VSW
    int "Vertical sync width"
    default 2
    depends on BSP_USING_DISPLAY

config BSP_DISPLAY_LVDS_LINK
    int "LVDS link (0=link0 PD.18-27, 1=link1 PD.8-17)"
    default 1
    range 0 1
    depends on BSP_USING_DISPLAY

config BSP_DISPLAY_LVDS_MODE
    int "LVDS data mapping (0=VESA24, 1=JEIDA24, 2=JEIDA18)"
    default 0
    range 0 2
    depends on BSP_USING_DISPLAY

config BSP_DISPLAY_FB_COUNT
    int "Framebuffer count (1=single, 2=double)"
    default 2
    range 1 2
    depends on BSP_USING_DISPLAY

config BSP_DISPLAY_PANEL_ENABLE_GPIO
    string "Panel enable/backlight GPIO"
    default "PC.7"
    depends on BSP_USING_DISPLAY

config BSP_DISPLAY_PANEL_ENABLE_LOW
    bool "Panel enable GPIO is active low"
    default n
    depends on BSP_USING_DISPLAY

config AIC_FB_RESERVED_SIZE
    hex "DDR reserved for framebuffers"
    default 0x2000000 if BSP_USING_DISPLAY
    default 0x0
    help
        The reserved region is taken from the top of the non-bootloader
        DDR area, below the 8 MB Bootloader reserve.  It is not part of the
        RT-Thread heap.

config BSP_USING_LVGL
    bool "Enable lvgl-aic-standalone (external LVGL 9.6)"
    default n
    depends on BSP_USING_DISPLAY
    help
        Builds the external lvgl-aic-standalone component.  The BSP does
        not contain the LVGL runtime, display/input port or demo.  Set
        LVGL_AIC_DIR and LVGL_DIR before building.

if BSP_USING_LVGL
config LVGL_AIC_USE_D21X_BACKEND
    bool "Use D21x double-buffer/PAN/VSync backend"
    default y

config LVGL_AIC_USE_GE_COPY
    bool "Use GE Normal bitblt for the LVGL frame copy"
    default n
    depends on LVGL_AIC_USE_D21X_BACKEND && BSP_USING_GE
    help
        Software frame copy is the validated baseline.  Enable this only
        after the software-rendered display path has been verified.

config LVGL_AIC_USE_TOUCH
    bool "Use an RT-Thread touch device as LVGL pointer input"
    default y
    depends on BSP_USING_TOUCH_GT911

if LVGL_AIC_USE_TOUCH
config LVGL_AIC_TOUCH_DEVICE
    string "LVGL touch device name"
    default "gt911"

config LVGL_AIC_TOUCH_SWAP_XY
    bool "Swap LVGL touch X/Y axes"
    default n

config LVGL_AIC_TOUCH_X_FLIP
    bool "Flip LVGL touch X axis"
    default n

config LVGL_AIC_TOUCH_Y_FLIP
    bool "Flip LVGL touch Y axis"
    default n
endif

config LVGL_AIC_DEMO_SMOKE
    bool "Build the D213 LVGL smoke demo"
    default y

config LVGL_AIC_UI_STACK_SIZE
    int "LVGL UI thread stack size"
    default 32768

config LVGL_AIC_UI_PRIORITY
    int "LVGL UI thread priority"
    default 15

config LVGL_AIC_UI_PERIOD_MS
    int "LVGL UI loop period (ms)"
    default 10
endif

endmenu

config BSP_USING_GE
    bool "Enable GE Normal mode (fill/blit/scale/blend/rotate)"
    default y
    help
        Enables the vendor GE Normal-mode HAL.  The GE CMD queue is not
        used on D21x.

menu "QSPI / SPI NAND"

config BSP_USING_QSPI0
    bool "Enable QSPI0 (SPI NAND bus)"
    default n
    help
        Enable D21x QSPI0 controller as RT-Thread QSPI bus "qspi0"
        for SPI NAND. Pins PB.0..PB.5 are QSPI0 (PB.2 = CS).
        This bus is mutually exclusive with SDMC0 on PB.0..PB.11
        (function 2).  This port implements the single-line
        synchronous CPU FIFO path only; DMA, interrupts and the
        multi-line command/data phases are future work.

    select RT_USING_SPI
    select RT_USING_QSPI

config BSP_QSPI0_FREQ
    int "QSPI0 default bus frequency (Hz)"
    default 24000000
    range 100000 200000000
    depends on BSP_USING_QSPI0
    help
        Requested SPI clock.  The driver selects the closest divider
        from the QSPI0 input clock and prints the actual rate at boot.

config BSP_QSPI0_INPUT_HZ
    int "QSPI0 input clock from the bootloader (Hz)"
    default 100000000
    range 1000000 300000000
    depends on BSP_USING_QSPI0
    help
        The ArtInChip bootloader programs the QSPI0 parent and CMU
        divider.  This BSP does not reconfigure the SoC clock tree;
        this value is the assumed input clock used for divider
        selection.  Measure QSPI0_CLK if the board bootloader uses a
        different rate and override this value.

config BSP_USING_SPINAND_MTD_NAND
    bool "Enable SPI NAND MTD (read-only stage)"
    default n
    depends on BSP_USING_QSPI0
    select RT_USING_MTD_NAND
    select RT_USING_DEVICE_OPS
    help
        Register read-only SPI NAND MTD partitions via
        rt_mtd_nand_register_device.  Only read_id / read_page /
        check_block are implemented; write_page / move_page /
        erase_block / mark_badblock return -RT_EPERM without
        touching the flash.
        The controller uses the RT-Thread QSPI bus "qspi0" and
        attaches device "spinand0".  Partitions are generated from
        pack/image_cfg.json at build time.

config BSP_SPINAND_READONLY
    bool "Register SPI NAND as read-only MTD"
    default y
    depends on BSP_USING_SPINAND_MTD_NAND
    help
        Guard for the read-only stage.  All mutating operations are
        rejected even though the upstream MTD register defaults to
        RT_DEVICE_FLAG_RDWR.

endmenu

endmenu
```
